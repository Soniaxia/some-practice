#include <math.h>
#include"..\include\tft_9325.h"


//PIN definition for 51
#ifdef MCU_51
	#include <STC_12.h>
	sbit CS = CS_PIN;
	sbit RS = RS_PIN;
	
	sbit LWR = WR_PIN;
	
	sbit RST = RST_PIN;
	sbit LRD = RD_PIN;
		#define RS_H RS=1
		#define RS_L RS=0
		
		#define WR_H LWR=1
		#define WR_L LWR=0
		
		#define RD_H LRD=1
		#define RD_L LRD=0
		
		
		#define CS_H  CS=1
		#define CS_L  CS=0
		
		
		#define RST_H RST=1
		#define RST_L RST=0
	#define CONST_TYPE code 
#else 
	#define CONST_TYPE const
#endif
#ifdef USING_BUS

#else
	void Write_Cmd(u8 x)
	{
		CS_L;
		RS_L;
		TRAN_DATA(x);
		
		WR_L;
		WR_H;
		CS_H;			
	}
	void Write_Data_U16(u16 y)
	{
		CS_L;
		RS_H;
		TRAN_DATA(y);
		WR_L;
		WR_H;
		CS_H;	
	}
	u16 Read_Data(void)
	{
		u16 y;
		TRAN_DATA(0xffff);	
		CS_L;
		RS_H;	
		RD_L;
		y = RE_DATA();
		RD_H;
		CS_H;
		return y;	
	}
#endif

void Init_data(u8 x,u16 y)
{
	Write_Cmd(x);
	Write_Data_U16(y);
}
void delayms(u16 count)
{
    int i,j;                                                                                
    for(i=0;i<count;i++)                                                                    
       {
	     for(j=0;j<DLAY_COUNT;j++);
       }                                                                                     
}



void ILI9325_Initial(void)
{ 
  delayms(500);                     //根据不同晶振速度可以调整延时，保障稳定显示

	
 Init_data(0x0001,0x0100); 
 Init_data(0x0002,0x0700); 
 Init_data(0x0003,0x1028); 
 Init_data(0x0004,0x0000); 
 Init_data(0x0008,0x0207);  
 Init_data(0x0009,0x0000);
 Init_data(0x000A,0x0000); 
 Init_data(0x000C,0x0000); 
 Init_data(0x000D,0x0000);
 Init_data(0x000F,0x0000);
//power on sequence VGHVGL
 Init_data(0x0010,0x0000);   
 Init_data(0x0011,0x0007);  
 Init_data(0x0012,0x0000);  
 Init_data(0x0013,0x0000); 
//vgh 
 Init_data(0x0010,0x1290);   
 Init_data(0x0011,0x0227);
 //delayms(100);
 //vregiout 
 Init_data(0x0012,0x001d); //0x001b
 //delayms(100); 
 //vom amplitude
 Init_data(0x0013,0x1500);
 //delayms(100); 
 //vom H
 Init_data(0x0029,0x0018); 
 Init_data(0x002B,0x000D); 

//gamma
 Init_data(0x0030,0x0004);
 Init_data(0x0031,0x0307);
 Init_data(0x0032,0x0002);// 0006
 Init_data(0x0035,0x0206);
 Init_data(0x0036,0x0408);
 Init_data(0x0037,0x0507); 
 Init_data(0x0038,0x0204);//0200
 Init_data(0x0039,0x0707); 
 Init_data(0x003C,0x0405);// 0504
 Init_data(0x003D,0x0F02); 
 //ram
 Init_data(0x0050,0x0000); 
 Init_data(0x0051,0x00EF);
 Init_data(0x0052,0x0000); 
 Init_data(0x0053,0x013F);  
 Init_data(0x0060,0xA700); 
 Init_data(0x0061,0x0001); 
 Init_data(0x006A,0x0000); 
 //
 Init_data(0x0080,0x0000); 
 Init_data(0x0081,0x0000); 
 Init_data(0x0082,0x0000); 
 Init_data(0x0083,0x0000); 
 Init_data(0x0084,0x0000); 
 Init_data(0x0085,0x0000); 
 //
 Init_data(0x0090,0x0010); 
 Init_data(0x0092,0x0600); 
 Init_data(0x0093,0x0003); 
 Init_data(0x0095,0x0110); 
 Init_data(0x0097,0x0000); 
 Init_data(0x0098,0x0000);
 Init_data(0x0007,0x0133);
}

 





/*===========================================================*/

/*************************************************************
函数名称:LCD_DefineDispWindow
功    能:定义显示窗体
参    数:x0:  窗体中X坐标中较小者
	 x1:  窗体中X坐标中较大者
	 y0:  窗体中Y坐标中较小者
	 y1:  窗体中Y坐标中较大者 
返 回 值:无
*************************************************************/
void LCD_SetPos(unsigned int x0,unsigned int x1,unsigned int y0,unsigned int y1)
{
  Init_data(WINDOW_XADDR_START,240-y1);
  Init_data(WINDOW_XADDR_END,240-y0);
  Init_data(WINDOW_YADDR_START,x0);
  Init_data(WINDOW_YADDR_END,x1);
  Init_data(GRAM_XADDR,240-y0);
  Init_data(GRAM_YADDR,x0);
  Write_Cmd (0x0022);//LCD_WriteCMD(GRAMWR);
}
void ClearScreen(u16 bColor)
{
 u16 i,j;
 LCD_SetPos(0,320,0,240);//320x240
 for (i=0;i<322;i++)
	{
	
	   for (j=0;j<241;j++)
	       Write_Data_U16(bColor);

	}
}
void TFT_Init(void)
{
	P0M0 = 0xff;
	P0M1 = 0x00;
	P2M0 = 0xff;
	P2M1 = 0x00;
	CS_H;
	RST_L;
	delayms(200);
	RST_H;
	delayms(250);
	ILI9325_Initial();
	delayms(300);
	ClearScreen(0x0);
}
u16 ili9325_BGR2RGB(u16 c)
{
  u16  r, g, b;

  b = (c>>0)  & 0x1f;
  g = (c>>5)  & 0x3f;
  r = (c>>11) & 0x1f;
  
  return( (b<<11) + (g<<5) + (r<<0) );
}
u16 get_point(int x,int y)
{ 
    u16 color;
    Write_Cmd(0x0020); 
    Write_Data_U16(240-y);   //设置X坐标位置 
    Write_Cmd(0x0021); 	
    Write_Data_U16(x);   //设置Y坐标位置 
	Write_Cmd(0x0022);
    color = Read_Data(); //获取指定座标的颜色值
	color = Read_Data(); //获取指定座标的颜色值
    return ili9325_BGR2RGB(color);
}
void TFT_ShowPoint2(int x0,int y0,int Color)
{
	unsigned int i,j;
	LCD_SetPos(x0,x0+1,y0,y0+1);
	for (i=y0;i<=y0+1;i++)
	{
	   for (j=x0;j<=x0+1;j++)
	   
	   Write_Data_U16(Color);

	}
}
void TFT_ShowPoint1(int x0,int y0,int Color)
{
    Write_Cmd(0x0020); 
    Write_Data_U16(240-y0);   //设置X坐标位置 
    Write_Cmd(0x0021); 	
    Write_Data_U16(x0);   //设置Y坐标位置 
	Write_Cmd(0x0022);
	Write_Data_U16(Color); 
}
CONST_TYPE unsigned char Font8x16[];
void TFT_PutChar(unsigned short x, unsigned short y, char c, unsigned int fColor, unsigned int bColor)
{
 unsigned int i,j;
 for(i=0; i<16;i++) {
		unsigned char m=Font8x16[c*16+i];
		for(j=0;j<8;j++) {
			if((m&0x80)==0x80) 
			{
				TFT_ShowPoint1(j+x,i+y,fColor);
			}
			else if (bColor!=0xff)
            {
				TFT_ShowPoint1(j+x,i+y,bColor);
			}
			m<<=1;
			}
		}
}
void TFT_PutStr(unsigned short x, unsigned short y, char* p, unsigned int fColor, unsigned int bColor)
{  	
	char i = 0;
	while(*p)
	{
        if(*p<0x80)
        {
          TFT_PutChar((x+i*8),y,*p,fColor,bColor);
          i++;
          p++;
        }
        else
        {
//          u16 j = 0;
//          while((((u8*)(Hzk[j]))[0] != ((u8*)p)[0])||(((u8*)(Hzk[j]))[1] != ((u8*)p)[1]))
//		  {
//		  	j = j+1;
//		  }
//         
//          TFT_ShowWord((x+i*8),y,Hzk[j]+2,fColor);
//          i = i+2;
//          p = p+2;
        }
	}
}
void TFT_Show_Bmp(unsigned int x,unsigned int y,unsigned int width,unsigned int high,unsigned short *ptr)
{
	  unsigned int i;
	  LCD_SetPos(x,x+width-1,y,y+high-1);

	  for(i = 0;i<(width*high);i++)
	  {		
	  		Write_Data_U16(ptr[i]);
	  }
}
void TFT_Show_Bmp_8b(unsigned int x,unsigned int y,unsigned int width,unsigned int high,unsigned char *ptr)
{
	  unsigned int i;
	  unsigned short rgb;
	  LCD_SetPos(x,x+width-1,y,y+high-1);

	  for(i = 0;i<(width*high);i++)
	  {		
				rgb = ((ptr[i]&0xe0)<<8)|((ptr[i]&0x38)<<6)|((ptr[i]&0x03)<<3);
	  		Write_Data_U16(rgb);
	  }
}
/****************************************************************************
* 名    称：void GUI_Line(u16 x0, u16 y0, u16 x1, u16 y1,u16 color)
* 功    能：在指定座标画直线
* 入口参数：x0     A点行座标
*           y0     A点列座标
*           x1     B点行座标
*           y1     B点列座标
*           color  线颜色
* 出口参数：无
* 说    明：
* 调用方法：GUI_Line(0,0,240,320,0x0000);
****************************************************************************/
void GUI_Line(u16 x0, u16 y0, u16 x1, u16 y1,u16 color)
{
 	u16 x,y;
 	u16 dx;// = abs(x1 - x0);
 	u16 dy;// = abs(y1 - y0);
	if(y0==y1)
	{
		if(x0<=x1)
		{
			x=x0;
		}
		else
		{
			x=x1;
			x1=x0;
		}
  		while(x <= x1)
  		{
   			ili9320_SetPoint(x,y0,color);
   			x++;
  		}
  		return;
	}
	else if(y0>y1)
	{
		dy=y0-y1;
	}
	else
	{
		dy=y1-y0;
	}
 
 	if(x0==x1)
	{
		if(y0<=y1)
		{
			y=y0;
		}
		else
		{
			y=y1;
			y1=y0;
		}
  		while(y <= y1)
  		{
   			ili9320_SetPoint(x0,y,color);
   			y++;
  		}
  		return;
	}
	else if(x0 > x1)
 	{
		dx=x0-x1;
  		x = x1;
  		x1 = x0;
  		y = y1;
  		y1 = y0;
 	}
 	else
 	{
		dx=x1-x0;
  		x = x0;
  		y = y0;
 	}

 	if(dx == dy)
 	{
  		while(x <= x1)
  		{

   			x++;
			if(y>y1)
			{
				y--;
			}
			else
			{
   				y++;
			}
   			ili9320_SetPoint(x,y,color);
  		}
 	}
 	else
 	{
 		ili9320_SetPoint(x, y, color);
  		if(y < y1)
  		{
   			if(dx > dy)
   			{
    			s16 p = dy * 2 - dx;
    			s16 twoDy = 2 * dy;
    			s16 twoDyMinusDx = 2 * (dy - dx);
    			while(x < x1)
    			{
     				x++;
     				if(p < 0)
     				{
      					p += twoDy;
     				}
     				else
     				{
      					y++;
      					p += twoDyMinusDx;
     				}
     				ili9320_SetPoint(x, y,color);
    			}
   			}
   			else
   			{
    			s16 p = dx * 2 - dy;
    			s16 twoDx = 2 * dx;
    			s16 twoDxMinusDy = 2 * (dx - dy);
    			while(y < y1)
    			{
     				y++;
     				if(p < 0)
     				{
      					p += twoDx;
     				}
     				else
     				{
      					x++;
      					p+= twoDxMinusDy;
     				}
     				ili9320_SetPoint(x, y, color);
    			}
   			}
  		}
  		else
  		{
   			if(dx > dy)
   			{
    			s16 p = dy * 2 - dx;
    			s16 twoDy = 2 * dy;
	    		s16 twoDyMinusDx = 2 * (dy - dx);
    			while(x < x1)
    			{
     				x++;
     				if(p < 0)
	     			{
    	  				p += twoDy;
     				}
     				else
     				{
      					y--;
	      				p += twoDyMinusDx;
    	 			}
     				ili9320_SetPoint(x, y,color);
    			}
   			}
	   		else
   			{
    			s16 p = dx * 2 - dy;
    			s16 twoDx = 2 * dx;
	    		s16 twoDxMinusDy = 2 * (dx - dy);
    			while(y1 < y)
    			{
     				y--;
     				if(p < 0)
	     			{
    	  				p += twoDx;
     				}
     				else
     				{
      					x++;
	      				p+= twoDxMinusDy;
    	 			}
     				ili9320_SetPoint(x, y,color);
    			}
   			}
  		}
 	}
}

/****************************************************************************
* 名    称：void GUI_Circle(u16 cx,u16 cy,u16 r,u16 color,u8 fill)
* 功    能：在指定座标画圆，可填充
* 入口参数：
* 出口参数：
* 说    明：
* 调用方法：
****************************************************************************/
void GUI_Circle(u16 cx,u16 cy,u16 r,u16 color,u8 fill)
{
	u16 x,y;
	for(x = 0;x<=r;x++)
	{
		y = sqrt(r*r-x*x);
		ili9320_SetPoint(cx+r+x,cy+r+y,color);
		ili9320_SetPoint(cx+r-x,cy+r-y,color);
		ili9320_SetPoint(cx+r+x,cy+r-y,color);
		ili9320_SetPoint(cx+r-x,cy+r+y,color);
		ili9320_SetPoint(cx+r+y,cy+r+x,color);
		ili9320_SetPoint(cx+r-y,cy+r-x,color);
		ili9320_SetPoint(cx+r+y,cy+r-x,color);
		ili9320_SetPoint(cx+r-y,cy+r+x,color);
		if(fill)
		{
			GUI_Line(cx+r-x,cy+r-y,cx+r-x,cy+r+y,color);
			GUI_Line(cx+r+x,cy+r-y,cx+r+x,cy+r+y,color);	
		}
	}

}
/****************************************************************************
* 名    称：void GUI_Rectangle(u16 x0, u16 y0, u16 x1, u16 y1,u16 color,u8 fill)
* 功    能：在指定区域画矩形，可填充颜色
* 入口参数：
* 出口参数：
* 说    明：
* 调用方法：
****************************************************************************/
void GUI_Rectangle(u16 x0, u16 y0, u16 x1, u16 y1,u16 color,u8 fill)
{
	if(fill)
	{
		u16 i,j;
        LCD_SetPos(x0,x1,y0,y1);
        for(i = y0;i<=y1;i++)
          for(j = x0;j<=x1;j++)
           {

		   	Write_Data_U16(color);
		   }
		return;
	}
	GUI_Line(x0,y0,x0,y1,color);
	GUI_Line(x0,y1,x1,y1,color);
	GUI_Line(x1,y1,x1,y0,color);
	GUI_Line(x1,y0,x0,y0,color);
}

/****************************************************************************
* 名    称：void  GUI_Square(u16 x0, u16 y0, u16 with, u16 color,u8 fill)
* 功    能：在指定区域画正方形，可填充颜色
* 入口参数：
* 出口参数：
* 说    明：
* 调用方法：
****************************************************************************/
void  GUI_Square(u16 x0, u16 y0, u16 with, u16 color,u8 fill)
{
	GUI_Rectangle(x0, y0, x0+with, y0+with, color,fill);
} 
void TFT_Show_Bmp2(u16 x,u16 y,u16 width,u16 high,u16 *ptr,u8 cut)
{
	  u16 i;
	  unsigned long tp[3];
	  LCD_SetPos(x,x+width-1,y,y+high-1);
	  for(i = 0;i<(width*high);i++)
	  {
	  	tp[0] = (((u16*)ptr)[i]&Red)*cut;
		tp[1] = (((u16*)ptr)[i]&Green)*cut;
		tp[2] = (((u16*)ptr)[i]&Blue)*cut;
		tp[0] = (tp[0]/32)&Red;
		tp[1] = (tp[1]/32)&Green;
		tp[2] = (tp[2]/32)&Blue;
		tp[0] = tp[0]|tp[2]|tp[1];
	  	Write_Data_U16(tp[0]);
	  }
}
//void TFT_ShowWord(u16 x,u16 y,unsigned char wd[32],u16 color)
//{
//	char i,j;
//  for(i = 0;i<16;i++)
//  {
//    for(j = 0;j<16;j++)
//    {
//      if((*wd&(1<<(7-j%8)))==(1<<(7-j%8)))
//      {
//      TFT_ShowPoint1(j+x,i+y,color);     
//      }
//      if(j==7)
//      wd++;
//      
//    }
//    wd++;
//  }
//}
CONST_TYPE unsigned char Font8x16[] = {
0x00, 0x00, 0x00, 0x00, 0x00, 0x00, 0x00, 0x00, 0x00, 0x00, 0x00, 0x00, 0x00, 0x00, 0x00, 0x00,
0x00, 0x00, 0x7e, 0x81, 0xa5, 0x81, 0x81, 0xbd, 0x99, 0x81, 0x81, 0x7e, 0x00, 0x00, 0x00, 0x00,
0x00, 0x00, 0x7e, 0xff, 0xdb, 0xff, 0xff, 0xc3, 0xe7, 0xff, 0xff, 0x7e, 0x00, 0x00, 0x00, 0x00,
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0x00, 0x00, 0x00, 0x00, 0x00, 0x00, 0x00, 0x00, 0x00, 0x00, 0x00, 0x00, 0x00, 0x00, 0x00, 0x00,
};